## arch/arm/mach-tegra/Kconfig.rej
```kconfig
diff a/arch/arm/mach-tegra/Kconfig b/arch/arm/mach-tegra/Kconfig	(rejected hunks)
@@ -101,6 +101,14 @@ config TEGRA_IRDA
 	  Adds support for Vishay IrDA transceiver at UARTB port
 	  of Verbier Boards(E1186 and E1198) with no ULPI rework done.
 
+config TEGRA_AHB
+	bool "Enable AHB driver for NVIDIA Tegra SoCs"
+	default y
+	help
+	  Adds AHB configuration functionality for NVIDIA Tegra SoCs,
+	  which controls AHB bus master arbitration and some
+	  perfomance parameters(priority, prefech size).
+
 comment "Tegra board type"
 
 source "arch/arm/mach-tegra/lge/Kconfig"
```

## drivers/nfc/Kconfig
```kconfig
#
# Near Field Communication (NFC) devices
#

menu "Near Field Communication (NFC) devices"
	depends on NFC

config BCM2079X_NFC
	tristate "BCM2079X NFC driver"
	depends on I2C
	select CRC_CCITT
	default n
	---help---
	  Say yes if you want BCM2079X Near Field Communication driver.
	  This is for i2c connected version. If unsure, say N here.
	  To compile this driver as a module, choose m here. The module will
	  be called bcm2079x.

config PN544_NFC
	tristate "PN544 NFC driver"
	depends on I2C
	select CRC_CCITT
	default n
	---help---
	  Say yes if you want PN544 Near Field Communication driver.
	  This is for i2c connected version. If unsure, say N here.

	  To compile this driver as a module, choose m here. The module will
	  be called pn544.

config NFC_PN533
	tristate "NXP PN533 USB driver"
	depends on USB
	help
	  NXP PN533 USB driver.
	  This driver provides support for NFC NXP PN533 devices.

	  Say Y here to compile support for PN533 devices into the
	  kernel or say M to compile it as module (pn533).

config NFC_WILINK
	tristate "Texas Instruments NFC WiLink driver"
	depends on TI_ST && NFC_NCI
	default n
	help
	  This enables the NFC driver for Texas Instrument's BT/FM/GPS/NFC
	  combo devices. This makes use of shared transport line discipline
	  core driver to communicate with the NFC core of the combo chip.

	  Say Y here to compile support for Texas Instrument's NFC WiLink driver
	  into the kernel or say M to compile it as module.
endmenu

menu "Near Field Communication (NFC) devices (legacy, lge x3)"
	depends on NFC_DEVICES

if MACH_X3
config LGE_NFC
	bool "NFC Device Enabled for LGE"
	default n

config LGE_NFC_PN544_C2
	bool "PN544 C2 NFC driver"
	depends on I2C
	select CRC_CCITT
	default n
	---help---
	  Say yes if you want PN544 Near Field Communication driver.
	  This is for i2c connected version. If unsure, say N here.

	  To compile this driver as a module, choose m here. The module will
	  be called pn544.

config LGE_NFC_PN544_C3
	bool "PN544 C3 NFC driver"
	depends on I2C
	select CRC_CCITT
	default n
	---help---
	  Say yes if you want PN544 Near Field Communication driver.
	  This is for i2c connected version. If unsure, say N here.

	  To compile this driver as a module, choose m here. The module will
	  be called pn544.

config LGE_NFC_PRESTANDBY
	bool "NFC STANBY MODE"
	default n
	---help---
	  Say yes if you want to change a power state of pn544 to stanby mode in Kernel.
	  If unsure, say N here.

config LGE_NFC_MULTICORE_FASTBOOT
	bool "NFC MultiThread"
	default n
	---help---
	  Say yes if multi thread is applied for pre-standby.
	  If unsure, say N here.

config LGE_NFC_HW_NV_AP3X
	bool "Nvidia AP3X Chipset"
	default n
endif #MACH_LGE
endmenu
```
